/*
   OLED
   Futura Academy: https://academy.futuranet.it/
   Webinar 2: Esp32 Futura Demoboard
   Dario Ciceri
   Canale YouTube: https://www.youtube.com/channel/UCuPuHsNjWX7huiztYu9ROQA
   Profilo Instagram: https://www.instagram.com/_dario.ciceri_/
*/

#include "Arduino.h"
#include "OLED.h"
#include <U8g2lib.h> //https://github.com/olikraus/u8g2/wiki/u8g2reference

#ifdef U8X8_HAVE_HW_SPI
#include <SPI.h>
#endif
#ifdef U8X8_HAVE_HW_I2C
#include <Wire.h>
#endif

U8G2_SSD1306_128X64_NONAME_1_HW_I2C u8g2(U8G2_R0, /* reset=*/ U8X8_PIN_NONE);

#define arrow_width 64
#define arrow_height 64

static const unsigned char arrow_bits[] U8X8_PROGMEM = {
  0x00, 0x00, 0x00, 0x00, 0x00, 0x00, 0x00, 0x00, 0x00, 0x00, 0x00, 0x00,
  0x00, 0x00, 0x00, 0x00, 0x00, 0x00, 0x00, 0x00, 0x00, 0x00, 0x00, 0x00,
  0x00, 0x00, 0x00, 0x00, 0x00, 0x00, 0x00, 0x00, 0x00, 0x00, 0x00, 0x00,
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  0x00, 0x00, 0x00, 0x00, 0x00, 0x00, 0x00, 0x00,
};

float tx, nx, p;
float ty, ny, py;
float rot, rotx, roty, rotz, rotxx, rotyy, rotzz, rotxxx, rotyyy, rotzzz;
int i; //0 to 360
int fl, scale; //focal length
int wireframe[12][2];

int originx = 64;
int originy = 32; //32

int front_depth = 20;
int back_depth = -20;

//Store cube vertices
int cube_vertex[8][3] = {
  { -20, -20, front_depth},
  {20, -20, front_depth},
  {20, 20, front_depth},
  { -20, 20, front_depth},
  { -20, -20, back_depth},
  {20, -20, back_depth},
  {20, 20, back_depth},
  { -20, 20, back_depth}
};

int fd = 0; //0=orthographic

void OLED::init() {
  Serial.println("_-_-_-_-_-_-_-_-_-_-_-_-_-_-_-_-_-_-_-_-_-_-_-_-_-_-_-_-_-_-_-_-_-_-_-_-_-_-_-_-_-_-_-_-_-_-_-_-_-_-_-_-_-_-_-_-_-_-_-_-_-_-_-_-_-_-_-_-_-_-");
  Serial.println("Display OLED attivato!");
  u8g2.begin();
}

void OLED::logo() {
  u8g2.firstPage();
  do {
    u8g2.setFont(u8g2_font_ncenB14_tr);
    u8g2.setCursor(0, 15);
    u8g2.print("Futura");
    u8g2.setCursor(0, 35);
    u8g2.print("Academy");
    u8g2.setCursor(0, 55);
    u8g2.print("Demoboard");
  } while ( u8g2.nextPage() );
  delay(1500);
}

void OLED::showArrow(int rot) {
  u8g2.firstPage();
  do {
    if (rot == 0) {
      u8g2.setDisplayRotation(U8G2_R3);
      u8g2.drawXBMP(0, 32, arrow_width, arrow_height, arrow_bits);
    }
    if (rot == 1) {
      u8g2.setDisplayRotation(U8G2_R1);
      u8g2.drawXBMP(0, 32, arrow_width, arrow_height, arrow_bits);
    }
    if (rot == 2) {
      u8g2.setDisplayRotation(U8G2_MIRROR);
      u8g2.drawXBMP(32, 0, arrow_width, arrow_height, arrow_bits);
    }
    if (rot == 3) {
      u8g2.setDisplayRotation(U8G2_R0);
      u8g2.drawXBMP(32, 0, arrow_width, arrow_height, arrow_bits);
    }
  } while ( u8g2.nextPage() );
  //delay(1000);
}

void OLED::showNear() {
  reset();
  u8g2.firstPage();
  do {
    u8g2.drawCircle(64, 32, 5);
    u8g2.drawCircle(64, 32, 10);
    u8g2.drawCircle(64, 32, 15);
    u8g2.drawFilledEllipse(64, 32, 20, 20);
    u8g2.drawCircle(64, 32, 25);
  } while ( u8g2.nextPage() );
}

void OLED::showFar() {
  reset();
  u8g2.firstPage();
  do {
    u8g2.drawCircle(64, 32, 25);
    u8g2.drawCircle(64, 32, 20);
    u8g2.drawCircle(64, 32, 15);
    u8g2.drawCircle(64, 32, 10);
    u8g2.drawFilledEllipse(64, 32, 5, 5);
  } while ( u8g2.nextPage() );
}

//3D_Cube for Arduino OLED module by Colin Ord, 9/1/2015
//A port of my original JustBasic Cube_3D demo to the Arduino Uno using U8G library.

void OLED::draw_vertices()
{
  u8g2.drawPixel (rotxxx, rotyyy);
}

void OLED::draw_wireframe()
{
  u8g2.drawLine(wireframe[0][0], wireframe[0][1], wireframe[1][0], wireframe[1][1]);
  u8g2.drawLine(wireframe[1][0], wireframe[1][1], wireframe[2][0], wireframe[2][1]);
  u8g2.drawLine(wireframe[2][0], wireframe[2][1], wireframe[3][0], wireframe[3][1]);
  u8g2.drawLine(wireframe[3][0], wireframe[3][1], wireframe[0][0], wireframe[0][1]);

  //cross face above
  u8g2.drawLine(wireframe[1][0], wireframe[1][1], wireframe[3][0], wireframe[3][1]);
  u8g2.drawLine(wireframe[0][0], wireframe[0][1], wireframe[2][0], wireframe[2][1]);

  u8g2.drawLine(wireframe[4][0], wireframe[4][1], wireframe[5][0], wireframe[5][1]);
  u8g2.drawLine(wireframe[5][0], wireframe[5][1], wireframe[6][0], wireframe[6][1]);
  u8g2.drawLine(wireframe[6][0], wireframe[6][1], wireframe[7][0], wireframe[7][1]);
  u8g2.drawLine(wireframe[7][0], wireframe[7][1], wireframe[4][0], wireframe[4][1]);

  u8g2.drawLine(wireframe[0][0], wireframe[0][1], wireframe[4][0], wireframe[4][1]);
  u8g2.drawLine(wireframe[1][0], wireframe[1][1], wireframe[5][0], wireframe[5][1]);
  u8g2.drawLine(wireframe[2][0], wireframe[2][1], wireframe[6][0], wireframe[6][1]);
  u8g2.drawLine(wireframe[3][0], wireframe[3][1], wireframe[7][0], wireframe[7][1]);
}

void OLED::show3dCube()
{
  //picture loop
  for (int angle = 0; angle <= 360; angle = angle + 3) {
    u8g2.firstPage();
    do {
      for (int i = 0; i < 8; i++) {

        rot = angle * 0.0174532; //0.0174532 = one degree
        //rotateY
        rotz = cube_vertex[i][2] * cos(rot) - cube_vertex[i][0] * sin(rot);
        rotx = cube_vertex[i][2] * sin(rot) + cube_vertex[i][0] * cos(rot);
        roty = cube_vertex[i][1];
        //rotateX
        rotyy = roty * cos(rot) - rotz * sin(rot);
        rotzz = roty * sin(rot) + rotz * cos(rot);
        rotxx = rotx;
        //rotateZ
        rotxxx = rotxx * cos(rot) - rotyy * sin(rot);
        rotyyy = rotxx * sin(rot) + rotyy * cos(rot);
        rotzzz = rotzz;

        //orthographic projection
        rotxxx = rotxxx + originx;
        rotyyy = rotyyy + originy;

        //store new vertices values for wireframe drawing
        wireframe[i][0] = rotxxx;
        wireframe[i][1] = rotyyy;
        wireframe[i][2] = rotzzz;

        draw_vertices();
      }

      draw_wireframe();

    } while (u8g2.nextPage());
  }
}

void OLED::reset() {
  u8g2.setDisplayRotation(U8G2_R0);
  u8g2.clear();
}

void OLED::clear(){
  u8g2.clear();
}

void OLED::displayText(int x, int y, String text) {
  u8g2.firstPage();
  do {
    u8g2.setFont(u8g2_font_9x15_tf);
    u8g2.setCursor(x, y);
    u8g2.print(text);
  } while ( u8g2.nextPage() );
}
